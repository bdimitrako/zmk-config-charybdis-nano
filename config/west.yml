## config/west.yml
```yaml
manifest:
  remotes:
    - name: zmkfirmware
      url-base: https://github.com/zmkfirmware
    - name: badjeff
      url-base: https://github.com/badjeff
  projects:
    # Pinned to v0.3-branch (Zephyr 3.5 era): zmk main moved to Zephyr 4.1
    # (Dec 2025), whose in-tree pmw3610 driver binding (motion-gpios) clashes
    # with the badjeff driver binding (irq-gpios) that the charybdis module
    # uses. Same era as the vendor firmware and the Temper config.
    - name: zmk
      remote: zmkfirmware
      revision: v0.3-branch
      import: app/west.yml
    # Pinned to 2025-07-15, for two reasons:
    # 1. Later commits renamed the Kconfig options to PMW3610_ALT_* and changed
    #    the DT compatible string for Zephyr 4.1 — breaks the charybdis module.
    # 2. Commits b7e61de08f (2025-09-06) through d6aff46463 (2025-12-16) READ
    #    the RES_STEP register (0x85) during init; this sensor batch does not
    #    support reading it (see the d6aff46463 commit message), so init fails
    #    and the trackball stays dead. This pin predates the read, matching
    #    the vendor firmware behaviour (verified by dissecting the vendor uf2:
    #    same pins SCK P0.08 / SDIO P0.17 / CS P0.20 / MOTION P0.06).
    - name: zmk-pmw3610-driver
      remote: badjeff
      revision: 14d39b7a6944d1014544a2382707b14724c22f49
    # NOTE: the victorlucachi/zmk-keyboards-charybdis module was vendored into
    # boards/shields/charybdis (2026-07-16) because its input-split design only
    # works with a dongle central: on a right-half central, local trackball
    # events are silently dropped. Our copy adds a direct input listener.
  self:
    path: config
```

## dts/bindings/behaviors/zmk,behavior-cpi-adjust.yaml
```yaml
# Runtime CPI (DPI) adjustment for the PMW3610 trackball. Each press applies
# the signed `step` to the current CPI, clamped to the sensor range 200-3200.
# The sensor resolution register works in 200 CPI increments.

description: PMW3610 trackball runtime CPI adjust

compatible: "zmk,behavior-cpi-adjust"

include: zero_param.yaml

properties:
  step:
    type: int
    required: true
    description: Signed CPI delta applied on each press (multiples of 200).
```
